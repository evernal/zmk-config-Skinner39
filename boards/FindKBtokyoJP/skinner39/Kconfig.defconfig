## boards/FindKBtokyoJP/skinner39/Kconfig.defconfig
```kconfig
# Copyright (c) 2020 The ZMK Contributors
# SPDX-License-Identifier: MIT

if BOARD_SKINNER39_LEFT

config ZMK_KEYBOARD_NAME
    default "SKINNER39"

config ZMK_SPLIT_ROLE_CENTRAL
    default y

endif # BOARD_SKINNER39_LEFT

if BOARD_SKINNER39_LEFT || BOARD_SKINNER39_RIGHT

config BOARD
    default "skinner39"

config ZMK_SPLIT
    default y

if USB

config USB_NRFX
    default y

config USB_DEVICE_STACK
    default y

endif # USB

if ZMK_DISPLAY

endif # ZMK_DISPLAY

if LVGL

config ZMK_DISPLAY_DEDICATED_THREAD_STACK_SIZE
    default 8192

config LV_Z_VDB_SIZE
    default 64

config LV_DPI_DEF
    default 148

config LV_Z_BITS_PER_PIXEL
    default 1

choice LV_COLOR_DEPTH
    default LV_COLOR_DEPTH_1
endchoice

endif # LVGL

config I2C
    default y

config SPI
    default y

endif # BOARD_SKINNER39_LEFT || BOARD_SKINNER39_RIGHT
```

## boards/FindKBtokyoJP/skinner39/board.yml
```yaml
boards:
  - name: skinner39_left
    vendor: FindKBtokyoJP
    socs:
      - name: nrf52840
  - name: skinner39_right
    vendor: FindKBtokyoJP
    socs:
      - name: nrf52840
```

## boards/evernal/skinner39/board.yml
```yaml
boards:
  - name: skinner39_left
    vendor: evernal
    socs:
      - name: nrf52840
  - name: skinner39_right
    vendor: evernal
    socs:
      - name: nrf52840
```
